## boards/nxp/s32k142_evb/Kconfig.defconfig
```kconfig
# Copyright 2023 NXP
# SPDX-License-Identifier: Apache-2.0

if BOARD_S32K142_EVB

if SERIAL

config UART_CONSOLE
	default y

endif # SERIAL

endif # BOARD_S32K142_EVB
```

## boards/nxp/s32k142_evb/Kconfig.s32k142_evb
```kconfig
# Copyright 2023 NXP
# SPDX-License-Identifier: Apache-2.0

config BOARD_S32K142_EVB
	select SOC_S32K142
	select SOC_PART_NUMBER_FS32K142UAT0VLLT
```

## drivers/gnss/Kconfig.quectel_eg915n
```kconfig
# Copyright (c) 2026 INOMO Technologies AG
# SPDX-License-Identifier: Apache-2.0

config GNSS_QUECTEL_EG915N
	bool "Quectel EG915N GNSS driver"
	default y
	depends on GNSS
	depends on DT_HAS_QUECTEL_EG915N_GNSS_ENABLED
	depends on MODEM_CELLULAR
	depends on GNSS_REFERENCE_FRAME_WGS84
	select MODEM_MODULES
	select MODEM_CHAT
	select MODEM_PIPE
	select MODEM_PIPELINK
	select GNSS_PARSE
	select GNSS_NMEA0183
	select GNSS_NMEA0183_MATCH
	help
	  GNSS receiver integrated in the Quectel EG915N modem, driven by
	  polling the modem over one of its CMUX channels.

if GNSS_QUECTEL_EG915N

config GNSS_QUECTEL_EG915N_INIT_PRIORITY
	int "Quectel EG915N GNSS driver initialization priority"
	default 92
	range 0 99
	help
	  Must be greater than MODEM_CELLULAR_INIT_PRIORITY, because the modem
	  driver creates the pipe this driver attaches to.

config GNSS_QUECTEL_EG915N_SATELLITES_COUNT
	int "Maximum satellite count"
	depends on GNSS_SATELLITES
	default 24
	help
	  Maximum number of satellites that can be decoded from the GSV
	  sentences reported by the modem. This does not affect how many
	  satellites the modem tracks, only how many can be reported in the
	  satellites callback.

endif # GNSS_QUECTEL_EG915N
```

## dts/bindings/gnss/quectel,eg915n-gnss.yaml
```yaml
# Copyright (c) 2026 INOMO Technologies AG
# SPDX-License-Identifier: Apache-2.0

description: |
  GNSS receiver integrated in the Quectel EG915N modem.

  This node must be a child of the modem node. The modem only emits NMEA
  sentences on its USB or debug UART port, so the driver instead polls the
  modem for positions over one of the modem's CMUX channels and needs no UART
  of its own.

  Example:

    &uart1 {
            modem: modem {
                    compatible = "quectel,eg915n";
                    mdm-power-gpios = <&gpio0 4 GPIO_ACTIVE_HIGH>;

                    gnss: gnss {
                            compatible = "quectel,eg915n-gnss";
                    };
            };
    };

compatible: "quectel,eg915n-gnss"

include: base.yaml

properties:
  modem-pipe-name:
    type: string
    default: "gnss_pipe"
    description: |
      Name of the modem pipe the driver sends AT commands on. Must match one of
      the pipe names defined by the parent modem driver.

  fix-rate:
    type: int
    default: 1000
    description: |
      Interval in milliseconds between position polls. The modem updates its
      position once per second, so shorter intervals report the same position
      more than once. May be changed at runtime through the GNSS API.
```

## dts/bindings/modem/quectel,eg915n.yaml
```yaml
# Copyright (c) 2026 INOMO Technologies AG
# SPDX-License-Identifier: Apache-2.0

description: Quectel EG915N modem

compatible: "quectel,eg915n"

include: zephyr,cellular-modem-device.yaml

properties:
  mdm-power-gpios:
    type: phandle-array
    required: true
```
